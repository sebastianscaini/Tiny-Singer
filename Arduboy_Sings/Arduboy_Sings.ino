#include <Arduboy2.h>

Arduboy2 arduboy;
BeepPin1 beep;

const uint8_t PROGMEM credits[] = {0x00, 0x00, 0x00, 0x00, 0x00, 0x00, 0x00, 0x00, 
0x00, 0x00, 0x00, 0x00, 0x00, 0x00, 0x00, 0x00, 
0x00, 0x00, 0x00, 0x00, 0x00, 0x00, 0x00, 0x00, 
0x00, 0x00, 0x00, 0x00, 0x00, 0x00, 0x00, 0x00, 
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0x00, 0x00, 0x00, 0x00, 0x00, 0x00, 0x00, 0x00};

const uint8_t PROGMEM controls[] =  {0x00, 0x00, 0x00, 0x00, 0x00, 0x00, 0x00, 0x00, 
0x00, 0x00, 0x00, 0x00, 0x00, 0x00, 0x00, 0x00, 
0x00, 0x00, 0x00, 0x00, 0x00, 0x00, 0x00, 0x00, 
0x00, 0x00, 0x00, 0x00, 0x00, 0x00, 0x00, 0x00, 
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0x00, 0x00, 0x00, 0x00, 0x00, 0x00, 0x00, 0x00};

const uint8_t PROGMEM mouthClosed[] = {0x00, 0x00, 0x00, 0x00, 0x00, 0x00, 0x00, 0x00, 
0x00, 0x00, 0x00, 0x00, 0x00, 0x00, 0x00, 0x00, 
0x00, 0x00, 0x00, 0x00, 0x00, 0x00, 0x00, 0x00, 
0x00, 0x00, 0x00, 0x00, 0x00, 0x00, 0x00, 0x00, 
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0x00, 0x00, 0x00, 0x00, 0x00, 0x00, 0x00, 0x00};

const uint8_t PROGMEM mouthOpen[] = {0x00, 0x00, 0x00, 0x00, 0x00, 0x00, 0x00, 0x00, 
0x00, 0x00, 0x00, 0x00, 0x00, 0x00, 0x00, 0x00, 
0x00, 0x00, 0x00, 0x00, 0x00, 0x00, 0x00, 0x00, 
0x00, 0x00, 0x00, 0x00, 0x00, 0x00, 0x00, 0x00, 
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0x00, 0x00, 0x00, 0x00, 0x00, 0x00, 0x00, 0x00};

bool controlsDisplaying = true;
bool creditsDisplaying = true;

void setup() {
  arduboy.begin();
  beep.begin();
  arduboy.setFrameRate(60);
}

void loop() {
  // pause render until it's time for the next frame
  if (!(arduboy.nextFrame()))
    return;
  arduboy.audio.enabled();
  beep.timer();
  arduboy.pollButtons();
  arduboy.clear();

  if(creditsDisplaying){
    arduboy.drawSlowXYBitmap(0, 0, credits, 128, 128, WHITE);

    if(arduboy.pressed(A_BUTTON) || arduboy.pressed(B_BUTTON) || arduboy.pressed(UP_BUTTON) || arduboy.pressed(LEFT_BUTTON) || arduboy.pressed(RIGHT_BUTTON)|| arduboy.pressed(DOWN_BUTTON)){
      creditsDisplaying = false;
    }
  }
  else if(controlsDisplaying){
    arduboy.drawSlowXYBitmap(0, 0, controls, 128, 128, WHITE);

    if(arduboy.pressed(A_BUTTON) || arduboy.pressed(B_BUTTON) || arduboy.pressed(UP_BUTTON) || arduboy.pressed(LEFT_BUTTON) || arduboy.pressed(RIGHT_BUTTON)|| arduboy.pressed(DOWN_BUTTON)){
      controlsDisplaying = false;
    }
  }
  else{
    if (arduboy.pressed(UP_BUTTON)) {
        if (arduboy.pressed(A_BUTTON)) {
          beep.tone(beep.freq(1175.000));
        } else if (arduboy.pressed(B_BUTTON)) {
          beep.tone(beep.freq(1318.500));
        }
        else{
          beep.tone(beep.freq(1318.500));
        }
        
        arduboy.drawSlowXYBitmap(0, 0, mouthOpen, 128, 128, WHITE);
    } else if (arduboy.pressed(DOWN_BUTTON)) {
        if (arduboy.pressed(A_BUTTON)) {
           beep.tone(beep.freq(698.500));
        } else if (arduboy.pressed(B_BUTTON)) {
           beep.tone(beep.freq(784.000));
        }
        else{
          beep.tone(beep.freq(740.000));
        }
        
      arduboy.drawSlowXYBitmap(0, 0, mouthOpen, 128, 128, WHITE);
    } else if (arduboy.pressed(LEFT_BUTTON)) {
        if (arduboy.pressed(A_BUTTON)) {
           beep.tone(beep.freq(831.000));
        } else if (arduboy.pressed(B_BUTTON)) {
           beep.tone(beep.freq(988.000));
        }
        else{
          beep.tone(beep.freq(880.000));
        }
        
      arduboy.drawSlowXYBitmap(0, 0, mouthOpen, 128, 128, WHITE);
    } else if (arduboy.pressed(RIGHT_BUTTON)) {
        if (arduboy.pressed(A_BUTTON)) {
           beep.tone(beep.freq(1046.500));
        } else if (arduboy.pressed(B_BUTTON)) {
           beep.tone(beep.freq(1046.500));
        }
        else{
          beep.tone(beep.freq(1046.500));
        }
        
      arduboy.drawSlowXYBitmap(0, 0, mouthOpen, 128, 128, WHITE);
    }
    else{
      arduboy.drawSlowXYBitmap(0, 0, mouthClosed, 128, 128, WHITE);
      beep.noTone();
    }
  }
  arduboy.display();
}
