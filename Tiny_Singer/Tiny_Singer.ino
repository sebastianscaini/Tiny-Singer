#include <Arduboy2.h>

Arduboy2 arduboy;
BeepPin1 beep;

const uint8_t PROGMEM mouthClosed[] = {0x00, 0x00, 0x00, 0x00, 0x00, 0x00, 0x00, 0x00, 
0x00, 0x00, 0x00, 0x00, 0x00, 0x00, 0x00, 0x00, 
0x00, 0x00, 0x00, 0x00, 0x00, 0x00, 0x00, 0x00, 
0x00, 0x00, 0x00, 0x00, 0x00, 0x00, 0x00, 0x00, 
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0x00, 0x00, 0x00, 0x00, 0x00, 0x00, 0x00, 0x00};

const uint8_t PROGMEM mouthOpen[] = {0x00, 0x00, 0x00, 0x00, 0x00, 0x00, 0x00, 0x00, 
0x00, 0x00, 0x00, 0x00, 0x00, 0x00, 0x00, 0x00, 
0x00, 0x00, 0x00, 0x00, 0x00, 0x00, 0x00, 0x00, 
0x00, 0x00, 0x00, 0x00, 0x00, 0x00, 0x00, 0x00, 
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0x00, 0x00, 0x00, 0x00, 0x00, 0x00, 0x00, 0x00};

void setup() {
  arduboy.begin();
  beep.begin();
  arduboy.setFrameRate(60);
}

void loop() {
  // pause render until it's time for the next frame
  if (!(arduboy.nextFrame()))
    return;
  arduboy.audio.enabled();
  beep.timer();
  arduboy.pollButtons();
  arduboy.clear();

  if (arduboy.pressed(UP_BUTTON)) {
      if (arduboy.pressed(A_BUTTON)) {
        beep.tone(beep.freq(493.883));
      } else if (arduboy.pressed(B_BUTTON)) {
        beep.tone(beep.freq(1975.533));
      }
      else{
        beep.tone(beep.freq(987.767));
      }
      
      arduboy.drawSlowXYBitmap(0, 0, mouthOpen, 128, 128, WHITE);
  } else if (arduboy.pressed(DOWN_BUTTON)) {
      if (arduboy.pressed(A_BUTTON)) {
         beep.tone(beep.freq(261.626));
      } else if (arduboy.pressed(B_BUTTON)) {
         beep.tone(beep.freq(1046.502));
      }
      else{
        beep.tone(beep.freq(523.251));
      }
      
    arduboy.drawSlowXYBitmap(0, 0, mouthOpen, 128, 128, WHITE);
  } else if (arduboy.pressed(LEFT_BUTTON)) {
      if (arduboy.pressed(A_BUTTON)) {
         beep.tone(beep.freq(293.665));
      } else if (arduboy.pressed(B_BUTTON)) {
         beep.tone(beep.freq(1174.659));
      }
      else{
        beep.tone(beep.freq(587.330));
      }
      
    arduboy.drawSlowXYBitmap(0, 0, mouthOpen, 128, 128, WHITE);
  } else if (arduboy.pressed(RIGHT_BUTTON)) {
      if (arduboy.pressed(A_BUTTON)) {
         beep.tone(beep.freq(440.000));
      } else if (arduboy.pressed(B_BUTTON)) {
         beep.tone(beep.freq(1760.000));
      }
      else{
        beep.tone(beep.freq(880.000));
      }
      
    arduboy.drawSlowXYBitmap(0, 0, mouthOpen, 128, 128, WHITE);
  }
  else{
    arduboy.drawSlowXYBitmap(0, 0, mouthClosed, 128, 128, WHITE);
    beep.noTone();
  }
  
  arduboy.display();
}
